/****************************************************
 *
 * Constellation viewer.
 *   Add text
 *
 ****************************************************/
/*************************************
 * ASCII bitmap for draw_rgbstring
 *************************************/
static char ta[][8]={ {0x00,0x00,0x00,0x00,0x00,0x00,0x00,0x00},
                      {0x30,0x78,0x78,0x78,0x30,0x00,0x30,0x00},
                      {0x6c,0x6c,0x6c,0x00,0x00,0x00,0x00,0x00},
                      {0x6c,0x6c,0xfe,0x6c,0xfe,0x6c,0x6c,0x00},
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                      {0x76,0xdc,0x00,0x00,0x00,0x00,0x00,0x00}
                    };
void get_strline(char *s,int y,char *l,int slen)
{
  int m,x,n;
  *l=0;
  for (m=0; *s; s++,m++)
  {
    n=(*s)-' '; if (n>95) return;
    if (m*8+8>slen) return;
    for (x=0; x<8; x++)
    {
      if (ta[n][y]&(0x80>>x)) l[x+m*8]=0xff; else l[x+m*8]=0;
    }
  }
}

void clear_displ(void)
{
  static int m;
  int n;
  unsigned char wrd[2];
  if (m) return;
  m=1;
  wrd[0]=wrd[1]=0x00;  
  write_cmdbyt2(0x15,0,127);                  // set OLED start/end X
  write_cmdbyt2(0x75,0,127);                  // set OLED start/end Y
  write_cmd(0x5C);            
  digitalWrite(SPI1_NSS_PIN, LOW);               // set CSN active for SPI transm.
  for (n=0; n<16384; n++) SPI.write(wrd,2);
  digitalWrite(SPI1_NSS_PIN, HIGH);              // set CSN inactive for SPI transm.
}

void add_str2arr(int x,int y,char *str,int flip)
{
  char ts[150];
  int fsize,ytxt,i,y0;
  int xstr,ystr;
  int chnkpos;
  char line[128*2];
  fsize=1;
  xstr=strlen(str)*8*fsize;
  ystr=8*fsize;
//  clear_displ();
  for (y0=0; y0<ystr; y0++)
  {
    int y1=y0;
    if (!flip) y1=ystr-1-y0;
    ytxt=(y1/fsize);
    get_strline(str,ytxt,ts,190);
    for (i=0; i<xstr; i++)
    {
      int i1=i;
      if (flip) i1=xstr-1-i;
      if (ts[i1/fsize])
      {
        line[i*2]=0xff;
        line[i*2+1]=0xff;
      }
      else
      {
        line[i*2]=0x00;
        line[i*2+1]=0x00;
      }
    }
    write_cmdbyt2(0x15,x,x+xstr);                  // set OLED start/end X
    write_cmdbyt2(0x75,y+y0,y+y0);                  // set OLED start/end Y
    write_cmd(0x5C);                               //
    digitalWrite(SPI1_NSS_PIN, LOW);               // set CSN active for SPI transm.
    SPI.write(line,xstr*2);                 // transmit 1 line of 1 dot to OLED 
    digitalWrite(SPI1_NSS_PIN, HIGH);              // set CSN inactive for SPI transm.
  }
}

#include <stdarg.h>
void str2oled(int x, int y,char *frmt,...)
{
  char xstr[20];
  va_list ap;
  va_start(ap,frmt);
  vsnprintf(xstr,16,frmt,ap);
  
  add_str2arr(x*8,y*8,xstr,0); 
}
